## drivers/fingerprint/Kconfig
```kconfig
#
# Fingerprint driver configuration
#

menuconfig FPC1020_REE
	tristate "FPC1020 fingerprint sensor support"
	help
	  The FPC1020 is a fingerprint sensor for smartphone, only manage
	  IRQ & HW reset gpio in the REE side.
	  If unsure, say N.
 
```

## drivers/input/fingerprint/Kconfig
```kconfig
#
# Fingerprint driver configuration
#
menuconfig INPUT_FINGERPRINT
	bool "Fingerprints"
	help
	  Say Y here, and a list of supported fingerprints will be displayed.
	  This option doesn't affect the kernel.

	  If unsure, say Y.

config FPC1020_REE
    tristate "FPC1020 fingerprint sensor support"
    help
      The FPC1020 is a fingerprint sensor for smartphone, only manage
      IRQ & HW reset gpio in the REE side.
	  Say Y here to enable fingerprint sensor support.

	  If unsure, say N.

	  To compile this driver as a module, choose M here.
 
```

## drivers/input/misc/vibrator/Kconfig
```kconfig
menu "zuk z2pro vibrator support"

config DRV2605L_HAPTICS
	tristate "TI DRV260X haptics support"
	depends on I2C && GPIOLIB
	select REGMAP_I2C
	help
	  Say Y to enable support for the TI DRV260X haptics driver.

	  To compile this driver as a module, choose M here: the
	  module will be called drv260x-haptics.

endmenu
```

## drivers/input/touchscreen/gt1151/Kconfig
```kconfig
#
# Goodix GT9xx Touchscreen driver
#

config GT1151_TOUCHPANEL_DRIVER
	bool "Goodix GT1151 touchpanel driver"
	depends on TOUCHSCREEN_GT1151
	default n
	help
	  This is the main file for touchpanel driver for Goodix GT1151
	  touchscreens.

	  Say Y here if you have a Goodix GT1151 touchscreen connected
	  to your system.

	  If unsure, say N.

	  To compile this driver as a module, choose M here: the
	  module will be called gt1x_update.

config GT1151_TOUCHPANEL_UPDATE
	bool "Goodix GT1151 touchpanel auto update support"
	depends on GT1151_TOUCHPANEL_DRIVER
	default n
	help
	  This enables support for firmware update for Goodix GT1151
	  touchscreens.

	  Say Y here if you have a Goodix GT1151 touchscreen connected
	  to your system.

	  If unsure, say N.

	  To compile this driver as a module, choose M here: the
	  module will be called gt9xx_update.

config GT1151_TOUCHPANEL_GENERIC
	tristate "Goodix GT1151 PM & status control"
	depends on GT1151_TOUCHPANEL_DRIVER
	default n
	help
	  This is PM & status control for Goodix GT1151
	  touchscreens.

	  Say Y here if you want have PM & status control.

	  If unsure, say N.

	  To compile this driver as a module, choose M here: the
	  module will be called gt9xx_generic.
config GT1151_TOUCHPANEL_EXTENTS
	tristate "Goodix GT1151 extents functions support here"
	depends on GT1151_TOUCHPANEL_DRIVER
	default n
	help
	  This is extents functions support for Goodix GT1151
	  touchscreens.

	  Say Y here if you want to install extents functions interface
	  to your system.

	  If unsure, say N.

	  To compile this driver as a module, choose M here: the
	  module will be called gt1x_extents.

config GT1151_TOUCHPANEL_TOOL
	tristate "Goodix GT1151 Tools for debuging"
	depends on GT1151_TOUCHPANEL_DRIVER
	default n
	help
	  This is tools interface support for Goodix GT1151
	  touchscreens.

	  Say Y here if you want to have GT1151 tools interface
	  to your system.

	  If unsure, say N.

	  To compile this driver as a module, choose M here: the
	  module will be called gt9xx_tool.
```

## drivers/misc/cclogic/Kconfig
```kconfig
#
# cclogic devices for type-C connector
#
menuconfig CCLOGIC
	tristate "cclogic devices for Type-C connector"
	depends on I2C
	help
	  This is cclogic devices for Type-C connector.

if CCLOGIC

config TYPEC_CCLOGIC_PI5USBD
	depends on I2C
	tristate "Pericom Pi5usb30216d Support"
	---help---
	  The Pericom pi5usb30216d chip is used as cc-logic of TYPEC 
	  interface.

config TYPEC_CCLOGIC_TUSB320HAI
	depends on I2C
	tristate "TI TUSB320Hai Support"
	---help---
	  The TI tusb320hai chip is used as cc-logic of TYPEC 

endif # CCLOGIC
```

## drivers/platform/zuk/Kconfig
```kconfig
# Zuk configuration options

config MACH_ZUK
	bool "ZUK device"
	depends on ARCH_MSM
	help
	  Support for Zuk products

config MACH_ZUK_MSM8996
	bool "ZUK MSM8996"
	depends on ARCH_MSM
	select MACH_ZUK
	help
	  Support for MSM8996 Zuk variants

menu "Zuk board selection"

	config MACH_ZUK_Z2_PLUS
		bool "ZUK_Z2_Plus_board"
		select MACH_ZUK_MSM8996
		help
		  Support for Zuk Z2 Plus variant

	config MACH_ZUK_Z2_ROW
		bool "ZUK_Z2_ROW_board"
		select MACH_ZUK_MSM8996
		help
		  Support for Zuk Z2_ROW variant
endmenu
```
