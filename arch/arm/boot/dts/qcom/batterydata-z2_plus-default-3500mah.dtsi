
qcom,default_2343799_lenovo_3500mah_averaged_masterslave_mar16th2016 {
	/* #2343799_Lenovo_3500mAh_averaged_MasterSlave_Mar16th2016*/
	qcom,max-voltage-uv = <4400000>;
	qcom,nom-batt-capacity-mah = <3500>;
	qcom,batt-id-kohm = <100>;
	qcom,battery-beta = <4250>;
	qcom,battery-type = "default_2343799_lenovo_3500mah_averaged_masterslave_mar16th2016";
	qcom,chg-rslow-comp-c1 = <3361614>;
	qcom,chg-rslow-comp-c2 = <4737910>;
	qcom,chg-rs-to-rslow = <843256>;
	qcom,chg-rslow-comp-thr = <0xA5>;
	qcom,checksum = <0x45AB>;
	qcom,gui-version = "PMI8996GUI - 1.1.0.0";
	qcom,fg-profile-data = [
		 E0 83 CA 7C 
		 02 81 05 77 
		 68 83 22 75 
		 F0 89 EA 94 
		 0F 82 90 9A 
		 7F BD 2C CA 
		 56 12 F5 83 
		 04 7D 05 81 
		 D2 76 51 83 
		 71 6B D4 72 
		 7D 85 52 82 
		 91 99 D4 BC 
		 A9 C9 58 0D 
		 DD 0D A0 5A 
		 14 70 50 FD 
		 E6 3C 3A 44 
		 C6 3A 00 00 
		 F3 44 D4 20 
		 FD 36 00 00 
		 00 00 00 00 
		 00 00 00 00 
		 CB 6A 22 69 
		 56 68 7D 88 
		 52 76 B6 69 
		 FB 4A 11 81 
		 3D 75 3D 68 
		 95 6D 1C A9 
		 1A 69 60 B3 
		 5D A0 71 0C 
		 28 00 FF 36 
		 F0 11 30 03 
		 00 00 00 0C 
	];
};
